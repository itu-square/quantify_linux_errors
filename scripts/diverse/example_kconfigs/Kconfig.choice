## scripts/diverse/example_kconfigs/Kconfig.choice
```kconfig
mainmenu "Linux/$ARCH $KERNELVERSION Kernel Configuration"
config ELVIS
    def_bool y
choice
config FOO
    bool "foo"
config BAR
    bool "bar"
config FOOBAR
    bool "foobar"
endchoice
```

## scripts/diverse/example_kconfigs/Kconfig.choice.new
```kconfig
mainmenu "Linux/$ARCH $KERNELVERSION Kernel Configuration"
config ELVIS
    def_bool y
config FOO
    bool "foo"
    select BAR=n
    select FOOBAR=n
config BAR
    bool "bar"
    select FOO=n
    select FOOBAR=n
config FOOBAR
    bool "foobar"
    select FOO=n
    select BAR=n
```

## scripts/example_kconfigs/Kconfig.depends
```kconfig
mainmenu "Linux/$ARCH $KERNELVERSION Kernel Configuration"
config ELVIS
    def_bool y
config FOO
    bool "foo"
config BAR
    bool
    prompt "bar"
    depends on FOO
    depends on FOOBAR
    select BARBAR
    select BARFOO
config FOOBAR
    bool "foobar"
config BARBAR
    bool "barbar"
config BARFOO
    bool "barfoo"
```
